#include "U8glib.h"
#include <Bounce2.h>
#include <avr/pgmspace.h>
#include <JeeLib.h>


// fonty
const u8g_fntpgm_uint8_t witch14n[317] U8G_FONT_SECTION("witch14n") = {
  0,31,33,253,250,15,0,0,0,0,48,57,0,15,0,15,
  0,9,15,30,11,1,0,56,0,62,0,70,0,67,0,195,
  0,195,128,195,128,195,128,195,128,195,128,195,128,67,0,67,
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  98,195,195,195,199,231,71,2,98,96,108,124,56};
  
const u8g_fntpgm_uint8_t witch18n[455] U8G_FONT_SECTION("witch18n") = {
  0,41,43,252,248,19,0,0,0,0,48,57,0,19,0,19,
  0,12,19,38,14,1,0,30,0,63,0,51,128,97,192,97,
  224,224,224,224,224,224,240,224,240,224,240,224,240,224,240,224,
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  0,127,0,63,0,28,0};
  
const u8g_fntpgm_uint8_t witch22n[558] U8G_FONT_SECTION("witch22n") = {
  0,49,52,252,246,23,0,0,0,0,48,57,0,23,0,23,
  0,14,23,46,16,1,0,7,128,31,192,63,224,56,112,120,
  112,112,120,112,56,240,56,240,56,240,60,240,60,240,60,240,
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  112,48,120,0,112,0,51,192,63,192,63,128,30,0};
  
const u8g_fntpgm_uint8_t witch26n[723] U8G_FONT_SECTION("witch26n") = {
  0,58,63,251,244,27,0,0,0,0,48,57,0,27,0,27,
  0,17,27,81,19,1,0,7,192,0,15,240,0,31,248,0,
  60,120,0,56,60,0,120,30,0,112,30,0,112,31,0,112,
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  192,15,0};
  
const u8g_fntpgm_uint8_t witch30n[973] U8G_FONT_SECTION("witch30n") = {
  0,67,72,250,242,31,0,0,0,0,48,57,0,31,0,31,
  0,20,31,93,22,1,0,1,224,0,7,248,0,15,252,0,
  31,254,0,30,15,0,60,15,128,60,7,128,120,7,192,120,
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  0,31,248,0,31,248,0,31,224,0,7,128,0};
  
const u8g_fntpgm_uint8_t witch34n[1165] U8G_FONT_SECTION("witch34n") = {
  0,76,80,249,242,35,0,0,0,0,48,57,0,36,0,35,
  0,22,35,105,24,1,0,1,248,0,3,252,0,7,255,0,
  15,255,128,31,15,128,30,7,192,62,3,224,62,3,224,124,
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  0,31,254,0,15,252,0,15,248,0,7,192,0};
  

const u8g_fntpgm_uint8_t witch38n[1413] U8G_FONT_SECTION("witch38n") = {
  0,85,91,248,239,39,0,0,0,0,48,57,0,40,255,39,
  0,25,40,160,29,2,255,0,16,0,0,1,254,0,0,3,
  255,0,0,7,255,192,0,15,255,224,0,15,135,224,0,31,
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  252,0,3,224,0};
  

const u8g_fntpgm_uint8_t witch42n[1719] U8G_FONT_SECTION("witch42n") = {
  0,93,101,248,237,43,0,0,0,0,48,57,0,44,255,43,
  0,28,43,172,32,2,255,0,126,0,0,1,255,128,0,3,
  255,224,0,7,255,240,0,7,255,248,0,15,193,252,0,31,
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  254,0,0,1,240,0,0};
  
  






//fonty

#define WIDTH 128

//#define DEBUG

#define INP 9
#define DISPLAY 2

#define LONG_PRESS 1000

char str[10];
uint8_t draw_state = 0;
uint8_t range_selected = 2;

Bounce btn = Bounce();

int btnSt = 0,x;
unsigned long btnTS = 0, selTS=0;

boolean disTS = false;


PROGMEM prog_uint16_t range[8][2] = {{10,50},{50,120},{100,500},{300,800},{700,1200},{900,2000},{1000,5000},{1200,9999}};
U8GLIB_SSD1306_128X64_2X u8g(U8G_I2C_OPT_NONE);	// I2C / TWI 


ISR(WDT_vect) { 
  Sleepy::watchdogEvent(); 
}


void draw(void) {
  switch(draw_state >> 3) {
  case 0:
    u8g.setDefaultBackgroundColor();
    u8g.drawPixel(1, 1);
    u8g.setDefaultForegroundColor();
    break;
  case 1: 
    draw_range_select(false); 
    break;
  case 2:
    draw_random(); 
    break;
  case 3:
    draw_range_select(true);
    break;
  }
}


void draw_range_select(boolean sel){
  int i,j;
  
  u8g.setFont(u8g_font_helvR08);
  u8g.drawStr((WIDTH - u8g.getStrWidth("Zvolte rozsah:"))/2, 22, "Zvolte rozsah:");

  i = pgm_read_word(&(range[draw_state&7][0]));
  j = pgm_read_word(&(range[draw_state&7][1]));
  
  sprintf(str,"%d-%d",i,j);

  if(sel){
    u8g.drawBox(0, 28, 127, 21);
    u8g.setDefaultBackgroundColor();    
  }

  u8g.setFont(u8g_font_fub17n);
  u8g.drawStr((WIDTH - u8g.getStrWidth(str))/2, 46, str); 
  if(sel){
    u8g.setDefaultForegroundColor();
  }
}

void draw_random(){  
int line;
switch(draw_state&7){
  case 0: line = 38; u8g.setFont(witch14n); break;
  case 1: line = 40; u8g.setFont(witch18n); break;
  case 2: line = 42; u8g.setFont(witch22n); break;
  case 3: line = 44; u8g.setFont(witch26n); break;
  case 4: line = 46; u8g.setFont(witch30n); break;
  case 5: line = 48; u8g.setFont(witch34n); break;  
  case 6: line = 50; u8g.setFont(witch38n); break;
  case 7: line = 52; u8g.setFont(witch42n); break;
}
  u8g.drawStr((WIDTH - u8g.getStrWidth(str))/2, line, str);  
}

void setup(void) {
  randomSeed(analogRead(0));
  
  pinMode(INP, INPUT); 
  digitalWrite(INP, HIGH);

  pinMode(DISPLAY,OUTPUT);
  digitalWrite(DISPLAY, HIGH);
  
  btn.attach(INP); 
  btn.interval(5);

  u8g.setRot180();
  
#ifdef DEBUG  
  Serial.begin(115200);
#endif
}


boolean btnChng, btnVal;
int old_draw_state=-1;

void loop(void) {

#ifdef DEBUG  
  Serial.print(draw_state);
  Serial.print(F(" zacinam zobrazovat ... "));
  unsigned long m = millis();
  int ii=0;
#endif

  if(old_draw_state != draw_state){


    u8g.firstPage();  
    do {
      draw();
#ifdef DEBUG  
ii++;
#endif

    } 
    while( u8g.nextPage() );
  old_draw_state = draw_state;
  
  }
  else{
#ifndef DEBUG  
 Sleepy::loseSomeTime(50);
#endif
#ifdef DEBUG  
 delay(50);
#endif      
    
  }
  
#ifdef DEBUG  
  unsigned long n = millis();
  Serial.print(F(" ... zobrazeno. "));
  Serial.print(n-m);
  Serial.print(F("ms. "));
  Serial.print(ii);
  Serial.println(F(" pruchodu."));
#endif
  
  
  if((draw_state >> 3) == 2){
    if((draw_state&7) < 7)
      draw_state++;
  }
  
  btnChng = btn.update();
  if(btnChng){
#ifdef DEBUG  
    Serial.println(F("Stisknute tlacitko"));
#endif
    btnVal = btn.read();
    
    if(btnVal == HIGH){ //tlacitko bylo pusteno
      if(btnSt == 2){ //dlouhy stisk
        if((draw_state >> 3) != 1) //nevybiram
          draw_state = 8 + range_selected;
        else{ //vybral jsem
          range_selected = draw_state&7;
          draw_state = 3*8+range_selected;
          selTS = millis();
          disTS = true;
        }
      }
      if(btnSt == 1){ //kratky stisk
        if(draw_state >> 3 == 1){ //vybiram range
          draw_state++; //posunu range o 1;
          if(draw_state >> 3 == 2) //nepretekl jsem
           draw_state = 8; 
        }
        else //jinak zacnu zobrazovat
        {
          x = pgm_read_word(&(range[range_selected][0])) + random(pgm_read_word(&(range[range_selected][1])) - pgm_read_word(&(range[range_selected][0])));
          sprintf(str, "%d", x);
#ifdef DEBUG  
          Serial.println();Serial.println();
          Serial.print(F("Generuji... "));
          Serial.print(pgm_read_word(&(range[range_selected][0])));
          Serial.print(F("..."));
          Serial.print(pgm_read_word(&(range[range_selected][1])));
          Serial.print(F(" - "));
          Serial.println(str);
          Serial.println();Serial.println();
#endif
       
          draw_state = 16;
        }
        
      }
    }
    else{ //tlacitko je stisknuto
      btnSt = 1; //je stisknuto alespon kratce
      btnTS = millis();
    }
  }
  
  if((btnSt == 1) && (millis() - btnTS >= LONG_PRESS)) //tlacitko je stitknuto dlouze
    btnSt = 2;
    
  if(disTS && ((long) millis() - (long) selTS > LONG_PRESS)){
    disTS = false;
    draw_state = 0;
#ifdef DEBUG  
          Serial.println();Serial.println();
          Serial.println(F("Cistim display "));
          Serial.print(millis());
          Serial.print(F(" "));
          Serial.print(selTS);
          Serial.println();Serial.println();
#endif    
  }
  
  
  if(draw_state == 23 && !disTS){
     disTS = true;
     selTS = millis()+10000L;
     
#ifdef DEBUG  
          Serial.println();Serial.println();
          Serial.print(F("Nastavuji cisteni "));
          Serial.print(millis());
          Serial.print(F(" "));
          Serial.print(selTS);
          Serial.println();Serial.println();
#endif    

  }
}

